#include <stdint.h>
#include <string.h>
#include "msc_disk.h"
#include "msc_ram_disk.h"

namespace USB
{

  MscRamDisk::MscRamDisk(bool is_writable) : MscDisk(RAM_DISK), is_writable_(is_writable)
  {
    // size_bytes_ = size_bytes / DISK_BLOCK_SIZE;
    sectorsize = DISK_BLOCK_SIZE;
    sectorcount = DISK_BLOCK_COUNT;
    ansiVersion = 0;
    deviceType = RAM_DISK;
    // Initialize with a file system
    memcpy(ram_disk_, readme_disk_, sizeof(readme_disk_));
  }

  bool MscRamDisk::ReadCapacity(uint32_t *sectorcount, uint32_t *sectorsize)
  {
    *sectorcount = DISK_BLOCK_COUNT;
    *sectorsize = DISK_BLOCK_SIZE;
    return true;
  }
  bool MscRamDisk::IsWritable()
  {
    return is_writable_;
  }
  bool MscRamDisk::TestUnitReady()
  {
    return true;
  }
  bool MscRamDisk::RequestSense(uint8_t *sense_key)
  {
    (void)sense_key;
    return true;
  }
  bool MscRamDisk::StartStopUnit(uint8_t power_condition, bool start, bool load_eject)
  {
    (void)power_condition;
    (void)start;
    (void)load_eject;
    return true;
  }
  uint32_t MscRamDisk::Read10(uint32_t lba, uint32_t offset, uint8_t *buffer, uint32_t buffersize)
  {
    if (lba >= DISK_BLOCK_COUNT)
      return -1;

    uint8_t const *addr = ram_disk_[lba] + offset;
    memcpy(buffer, addr, buffersize);

    return (int32_t)buffersize;
  }
  uint32_t MscRamDisk::Write10(uint32_t lba, uint32_t offset, uint8_t *buffer, uint32_t buffersize)
  {

    // out of ramdisk
    if (lba >= DISK_BLOCK_COUNT)
      return -1;

    uint8_t *addr = ram_disk_[lba] + offset;
    memcpy(addr, buffer, buffersize);

    return (int32_t)buffersize;
  }

//--------------------------------------------------------------------+
// LUN 0
//--------------------------------------------------------------------+
#define README0_CONTENTS \
  "LUN0: This is tinyusb's MassStorage Class demo.\r\n\r\n\
If you find any bugs or get any questions, feel free to file an\r\n\
issue at github.com/hathach/tinyusb"

  const uint8_t MscRamDisk::readme_disk_[DISK_BLOCK_COUNT][DISK_BLOCK_SIZE] =
      {
          //------------- Block0: Boot Sector -------------//
          // byte_per_sector    = DISK_BLOCK_SIZE; fat12_sector_num_16  = DISK_BLOCK_NUM;
          // sector_per_cluster = 1; reserved_sectors = 1;
          // fat_num            = 1; fat12_root_entry_num = 16;
          // sector_per_fat     = 1; sector_per_track = 1; head_num = 1; hidden_sectors = 0;
          // drive_number       = 0x80; media_type = 0xf8; extended_boot_signature = 0x29;
          // filesystem_type    = "FAT12   "; volume_serial_number = 0x1234; volume_label = "TinyUSB 0  ";
          // FAT magic code at offset 510-511
          {
              0xEB, 0x3C, 0x90, 0x4D, 0x53, 0x44, 0x4F, 0x53, 0x35, 0x2E, 0x30, 0x00, 0x02, 0x01, 0x01, 0x00,
              0x01, 0x10, 0x00, 0x10, 0x00, 0xF8, 0x01, 0x00, 0x01, 0x00, 0x01, 0x00, 0x00, 0x00, 0x00, 0x00,
              0x00, 0x00, 0x00, 0x00, 0x80, 0x00, 0x29, 0x34, 0x12, 0x00, 0x00, 'T', 'i', 'n', 'y', 'U',
              'S', 'B', ' ', '0', ' ', ' ', 0x46, 0x41, 0x54, 0x31, 0x32, 0x20, 0x20, 0x20, 0x00, 0x00,

              // Zero up to 2 last bytes of FAT magic code
              0x00, 0x00, 0x00, 0x00, 0x00, 0x00, 0x00, 0x00, 0x00, 0x00, 0x00, 0x00, 0x00, 0x00, 0x00, 0x00,
              0x00, 0x00, 0x00, 0x00, 0x00, 0x00, 0x00, 0x00, 0x00, 0x00, 0x00, 0x00, 0x00, 0x00, 0x00, 0x00,
              0x00, 0x00, 0x00, 0x00, 0x00, 0x00, 0x00, 0x00, 0x00, 0x00, 0x00, 0x00, 0x00, 0x00, 0x00, 0x00,
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              0x00, 0x00, 0x00, 0x00, 0x00, 0x00, 0x00, 0x00, 0x00, 0x00, 0x00, 0x00, 0x00, 0x00, 0x55, 0xAA},

          //------------- Block1: FAT12 Table -------------//
          {
              0xF8, 0xFF, 0xFF, 0xFF, 0x0F // // first 2 entries must be F8FF, third entry is cluster end of readme file
          },

          //------------- Block2: Root Directory -------------//
          {
              // first entry is volume label
              'T', 'i', 'n', 'y', 'U', 'S', 'B', ' ', '0', ' ', ' ', 0x08, 0x00, 0x00, 0x00, 0x00,
              0x00, 0x00, 0x00, 0x00, 0x00, 0x00, 0x4F, 0x6D, 0x65, 0x43, 0x00, 0x00, 0x00, 0x00, 0x00, 0x00,
              // second entry is readme file
              'R', 'E', 'A', 'D', 'M', 'E', '0', ' ', 'T', 'X', 'T', 0x20, 0x00, 0xC6, 0x52, 0x6D,
              0x65, 0x43, 0x65, 0x43, 0x00, 0x00, 0x88, 0x6D, 0x65, 0x43, 0x02, 0x00,
              sizeof(README0_CONTENTS) - 1, 0x00, 0x00, 0x00 // readme's files size (4 Bytes)
          },

          //------------- Block3: Readme Content -------------//
          README0_CONTENTS};
} // end USB namespace
